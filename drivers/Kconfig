## drivers/sensor/Kconfig
```kconfig
# SPDX-License-Identifier: Apache-2.0

if SENSOR
rsource "aht20/Kconfig"
endif # SENSOR
```

## west.yml
```yaml
# Copyright (c) 2021 Nordic Semiconductor ASA
# SPDX-License-Identifier: Apache-2.0

manifest:
  self:
    path: rak-sid
    west-commands: scripts/west-commands.yml
    userdata:
      patches_dirs:
        - patches/west-sidewalk

  remotes:
    - name: nrfconnect
      url-base: https://github.com/nrfconnect

  projects:
    - name: sidewalk
      remote: nrfconnect
      repo-path: sdk-sidewalk
      revision: v1.0.0-add-on
      import: true

self:
    path: rak-sid
```
